## idf/sensor_unit/main/Kconfig.projbuild
```kconfig
menu "Sensor configuration"

    choice
        prompt "Select type of sensor"
    config DOOR_SENSOR
        bool "Door sensor"
    config PIR_SENSOR
        bool "PIR sensor"
    endchoice


endmenu
```
